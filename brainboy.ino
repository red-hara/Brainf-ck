#include <Arduboy2.h>
#include <EEPROM.h>

Arduboy2 arduboy;

#define LINE_WIDTH 20
#define OFFSET 4
#define DATA_SIZE 256
#define PROG_SIZE 512
#define OUTP_SIZE 40
#define INPU_SIZE 40

const byte PROGMEM qr[] = {0xF0, 0x00, 0x00, 0x00, 0x00, 0x00, 0x00, 0x00, 
0x00, 0x00, 0x00, 0x00, 0x00, 0x00, 0x00, 0x0F, 
0x80, 0x07, 0xE0, 0x00, 0x00, 0x00, 0x00, 0x00, 
0x00, 0x00, 0x00, 0x00, 0x00, 0x00, 0x00, 0x01, 
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0xFF, 0xFF, 0xF8, 0x00, 0x00, 0x00, 0x00, 0x0F};

char data[DATA_SIZE];
char prog[PROG_SIZE] = {'+','+','+','+','+','+','+','+','[','>','+','+','+','+','[','>','+','+','>','+','+','+','>','+','+','+','>','+','<','<','<','<','-',']','>','+','>','+','>','-','>','>','+','[','<',']','<','-',']','>','>','.','>','-','-','-','.','+','+','+','+','+','+','+','.','.','+','+','+','.','>','>','.','<','-','.','<','.','+','+','+','.','-','-','-','-','-','-','.','-','-','-','-','-','-','-','-','.','>','>','+','.','>','+','+','.'};
char output[OUTP_SIZE];
char input[INPU_SIZE];
short datap = 0;
short progp = 0;
byte outpp = 0;
byte inpup = 0;

byte progoffsl = 0;
char inputchar = 32;

enum editmode {
  MOVE,
  LETTER,
  CONTEXT,
} editmode;

enum mode {
  EDIT,
  RUN,
  TYPE,
} mode;

void setup() {
  Serial.begin(9600);
  arduboy.begin();
  arduboy.setFrameRate(20);
  arduboy.clear();
  arduboy.drawSlowXYBitmap(0, 0, qr, 128, 64, WHITE);
  arduboy.display();
  while(!arduboy.pressed(A_BUTTON )) {}
  arduboy.waitNoButtons();
  mode = EDIT;
  editmode = MOVE;
  tryLoad();
}

void loop() {
  while (!arduboy.nextFrameDEV()) {return;}
  arduboy.clear();
  arduboy.pollButtons();
  printOutput();
  printInput();
  switch (mode) {
    case RUN:
      executeprog();
      break;
    case TYPE:
      type();
      break;
    case EDIT:
      edit();
      break;
  }
  printProg();
  drawBorder();
  arduboy.display();
}

void tryLoad() {
  short signature;
  EEPROM.get(EEPROM_STORAGE_SPACE_START, signature);
  if (signature != 6174) {
    return;
  }
  for (short s = 0; s < 512; s++) {
    prog[s] = EEPROM.read(s + sizeof(short) + EEPROM_STORAGE_SPACE_START);
  }
}

void save() {
  short signature = 6174;
  EEPROM.put(EEPROM_STORAGE_SPACE_START, signature);
  for (short s = 0; s < 512; s++) {
    EEPROM.update(s + sizeof(short) + EEPROM_STORAGE_SPACE_START, prog[s]);
  }
}

void write() {
  short counter = 0;
  do {
    Serial.print(prog[counter]);
    counter ++;
  } while (prog[counter] != 0 && counter < 511);
}

void read() {
  short counter = 0;
  while (Serial.available() > 0 && counter < PROG_SIZE) {
    char value = Serial.read();
    if (value == '>' || value == '<' || value == '+' || value == '-' || value == '.' || value == ',' || value == '[' || value == ']') {
      prog[counter] = value;
      counter ++;
    }
  }
  for (short b = counter; b < PROG_SIZE; b++) {
    prog[b] = 0;
  }
}

void executeprog() {
  arduboy.setRGBled(16, 16, 0);
  if (arduboy.pressed(A_BUTTON | B_BUTTON)) {
    mode = EDIT;
  }
  switch (prog[progp]) {
    case '>':
      datap ++;
      break;
    case '<':
      datap --;
      break;
    case '+':
      data[datap] ++;
      break;
    case '-':
      data[datap] --;
      break;
    case '.':
      print();
      break;
    case ',':
      mode = TYPE;
      break;
    case '[':
      if (data[datap] == 0) {
        jumpForward();
      }
      break;
    case ']':
      if (data[datap] != 0) {
        jumpBack();
      }
      break;
  }
  progp ++;
  if (prog[progp] == 0) {
    mode = EDIT;
  }
}

void edit() {
  switch (editmode) {
    case MOVE:
      arduboy.setRGBled(0, 0, 16);
      if (arduboy.justPressed(A_BUTTON)) {
        editmode = LETTER;
      }
      if (arduboy.justPressed(B_BUTTON)) {
        editmode = CONTEXT;
      }
      if (arduboy.justPressed(UP_BUTTON)) {
        if (progp >= LINE_WIDTH) {
          progp -= LINE_WIDTH;
        }
      }
      if (arduboy.justPressed(DOWN_BUTTON)) {
        if (progp < 255 - LINE_WIDTH) {
          progp += LINE_WIDTH;
          while (prog[progp] == 0 && progp > 0) {
            progp --;
          }
        }
      }
      if (arduboy.justPressed(LEFT_BUTTON)) {
        if (progp > 0) {
          progp --;
        }
      }
      if (arduboy.justPressed(RIGHT_BUTTON)) {
        if (prog[progp + 1] != 0) {
          progp ++;
        }
      }
      break;
    case LETTER:
      arduboy.setRGBled(16, 16, 16);
      if (arduboy.justPressed(A_BUTTON)) {
        editmode = MOVE;
      }
      if (arduboy.justPressed(B_BUTTON)) {
        editmode = CONTEXT;
      }
      if (arduboy.justPressed(UP_BUTTON)) {
        increaseLetter();
      }
      if (arduboy.justPressed(DOWN_BUTTON)) {
        decreaseLetter();
      }
      if (arduboy.justPressed(LEFT_BUTTON)) {
        erase();
      }
      if (arduboy.justPressed(RIGHT_BUTTON)) {
        insert();
      }
      break;
    case CONTEXT:
      arduboy.setRGBled(0, 0, 0);
      printContext();
      if (arduboy.justPressed(UP_BUTTON)) {
        for (byte b = 0; b < OUTP_SIZE; b++) {
          output[b] = 0;
        }
        for (byte b = 0; b < INPU_SIZE; b++) {
          input[b] = 0;
        }
        for (short b = 0; b < DATA_SIZE; b++) {
          data[b] = 0;
        }
        outpp = 0;
        inpup = 0;
        progp = 0;
        mode = RUN;
        editmode = MOVE;
      }
      if (arduboy.justPressed(DOWN_BUTTON)) {
        save();
        editmode = MOVE;
      }
      if (arduboy.justPressed(RIGHT_BUTTON)) {
        write();
        editmode = MOVE;
      }
      if (arduboy.justPressed(LEFT_BUTTON)) {
        read();
        editmode = MOVE;
      }
      if (arduboy.justPressed(A_BUTTON)) {
        editmode = MOVE;
      }
      if (arduboy.justPressed(B_BUTTON)) {
        editmode = MOVE;
      }
      break;
  }
}

void increaseLetter() {
  switch (prog[progp]) {
   case '>':
      prog[progp] = '<';
      break;
    case '<':
      prog[progp] = '+';
      break;
    case '+':
      prog[progp] = '-';
      break;
    case '-':
      prog[progp] = '.';
      break;
    case '.':
      prog[progp] = ',';
      break;
    case ',':
      prog[progp] = '[';
      break;
    case '[':
      prog[progp] = ']';
      break;
    case ']':
      prog[progp] = '>';
  }
}

void decreaseLetter() {
  switch (prog[progp]) {
   case '>':
      prog[progp] = ']';
      break;
    case '<':
      prog[progp] = '>';
      break;
    case '+':
      prog[progp] = '<';
      break;
    case '-':
      prog[progp] = '+';
      break;
    case '.':
      prog[progp] = '-';
      break;
    case ',':
      prog[progp] = '.';
      break;
    case '[':
      prog[progp] = ',';
      break;
    case ']':
      prog[progp] = '[';
  }
}

void erase() {
  short counter = progp;
  do {
    prog[counter] = prog[counter + 1];
    counter ++;
  } while(prog[counter] != 0 && counter < PROG_SIZE - 1);
  prog[counter] = 0;
}

void insert() {
  short counter = progp;
  char prev;
  char forw = prog[counter];
  if (counter == 0 && prog[counter] == 0) {
    prog[counter] = '.';
  } else {
    do {
      prev = prog[counter + 1];
      prog[counter + 1] = forw;
      forw = prev;
      counter ++;
    } while(prog[counter] != 0 && counter < PROG_SIZE - 1);
  }
}

void type() {
  arduboy.setRGBled(16, 0, 0);
  if (input[inpup] == 0) {
    input[inpup] = ' ';
  }
  if (arduboy.justPressed(A_BUTTON)) {
    data[datap] = input[inpup];
    inpup ++;
    mode = RUN;
  }
  if (arduboy.justPressed(UP_BUTTON)) {
    input[inpup] = ((short)input[inpup] - 32 + 94 - 1) % (94) + 32;
  }
  if (arduboy.justPressed(DOWN_BUTTON)) {
    input[inpup] = ((short)input[inpup] - 32 + 94 + 1) % (94) + 32;
  }
}

void print() {
  output[outpp] = data[datap];
  outpp ++;
}

void jumpForward() {
  short counter = 1;
  do {
    progp ++;
    if (prog[progp] == '[') {
      counter ++;
    }
    if (prog[progp] == ']') {
      counter --;
    }
  } while (counter > 0 && prog[progp] != 0);
}

void jumpBack() {
  short counter = 1;
  do {
    progp --;
    if (prog[progp] == '[') {
      counter --;
    }
    if (prog[progp] == ']') {
      counter ++;
    }
  } while (counter > 0 && prog[progp] > 0);
}

void printProg() {
  arduboy.setCursor(OFFSET, 0);
  char current = 0;
  short counter = 0;
  byte line = 0;
  byte pointerline = progp / LINE_WIDTH;
  if (pointerline > progoffsl + 3) {
    progoffsl = pointerline - 2;
  } else if (pointerline < progoffsl) {
    progoffsl = pointerline;
  }
  
  do {
    current = prog[counter + progoffsl * LINE_WIDTH];
    if (counter + progoffsl * LINE_WIDTH == progp) {
      arduboy.setTextColor(BLACK);
      arduboy.setTextBackground(WHITE);
    }
    arduboy.print(current);
    if (counter + progoffsl * LINE_WIDTH == progp) {
      arduboy.setTextColor(WHITE);
      arduboy.setTextBackground(BLACK);
    }
    if (counter % LINE_WIDTH == LINE_WIDTH - 1) {
      line ++;
      arduboy.setCursor(OFFSET, line * 8);
    }
    counter ++;
  } while (current != 0 && counter < LINE_WIDTH * 4 && counter < PROG_SIZE);
}

void printOutput() {
  arduboy.setCursor(OFFSET, 32);
  char current = 0;
  short counter = 0;
  byte line = 0;
  do {
    current = output[counter];
    arduboy.print(current);
    if (counter % LINE_WIDTH == LINE_WIDTH - 1) {
      line ++;
      arduboy.setCursor(OFFSET, line * 8 + 32);
    }
    counter ++;
  } while (current != 0 && counter < LINE_WIDTH * 2);
}

void printInput() {
  arduboy.setCursor(OFFSET, 48);
  char current = 0;
  short counter = 0;
  byte line = 0;
  do {
    current = input[counter];
    arduboy.print(current);
    if (counter % LINE_WIDTH == LINE_WIDTH - 1) {
      line ++;
      arduboy.setCursor(OFFSET, line * 8 + 48);
    }
    counter ++;
  } while (current != 0 && counter < LINE_WIDTH * 2);
}

void printContext() {
  arduboy.setTextColor(BLACK);
  arduboy.setTextBackground(WHITE);
  arduboy.setCursor(21+32, 32);
  arduboy.print("RUN");
  arduboy.setCursor(32, 40);
  arduboy.print("READ");
  arduboy.setCursor(34+32, 40);
  arduboy.print("WRITE");
  arduboy.setCursor(18+32, 48);
  arduboy.print("SAVE");
  arduboy.setTextColor(WHITE);
  arduboy.setTextBackground(BLACK);
}

void drawBorder() {
  arduboy.drawLine(0, 0, 3, 0);
  arduboy.drawLine(0, 0, 0, 3);
  arduboy.drawLine(0, 63, 3, 63);
  arduboy.drawLine(0, 63, 0, 60);

  arduboy.drawLine(127, 0, 124, 0);
  arduboy.drawLine(127, 0, 127, 3);
  arduboy.drawLine(127, 63, 124, 63);
  arduboy.drawLine(127, 63, 127, 60);
}
